VERSION ""

NS_ :

BS_:

BU_: ECU_ENGINE ECU_GEARBOX ECU_ABS ECU_BSI

BO_ 535 MSG_217: 8 ECU_BSI
 SG_ BRAKE_PEDAL_SWITCH : 16|8@1+ (1,0) [0|255] "" ECU_ENGINE

BO_ 296 MSG_128: 8 ECU_BSI
 SG_ EGS6_GEAR_SELECTOR : 8|8@1+ (1,0) [0|255] "" ECU_ENGINE

BO_ 904 MSG_388: 8 ECU_BSI
 SG_ ELECTRIC_HANDBRAKE_SWITCH : 8|8@1+ (1,0) [0|255] "" ECU_ENGINE
